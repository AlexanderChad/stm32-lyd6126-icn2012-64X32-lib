#include "ledmatrix.h"

#include <main.h>

#define LED_MATRIX_WIDTH        64
#define LED_MATRIX_HEIGHT       32


static uint8_t swbuff = 0;
static uint16_t TOnLP = 300;
static uint8_t RAW_DISPLAY_0[2304] = {0,47,102,0,152,0,0,68,0,192,3,0,0,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0,0};
static uint8_t RAW_DISPLAY_1[2304] = {0,1,0,0,152,0,0,68,0,0,0,0,0,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0,0};

static uint8_t *RAW_DISPLAY;
static uint8_t *RAW_DISPLAY_B;

void digitalWrite(GPIO_TypeDef * Port, uint16_t NumP, uint8_t  stat) {
if(stat){
	HAL_GPIO_WritePin(Port, NumP, GPIO_PIN_SET);
}else{
	HAL_GPIO_WritePin(Port, NumP, GPIO_PIN_RESET);
}
}

void led_matrix_init(void)
{
	GPIO_InitTypeDef GPIO_InitStruct = {0};

	  /* GPIO Ports Clock Enable */
	  __HAL_RCC_GPIOE_CLK_ENABLE();
	  __HAL_RCC_GPIOB_CLK_ENABLE();
	  __HAL_RCC_GPIOD_CLK_ENABLE();
	  __HAL_RCC_GPIOC_CLK_ENABLE();
	  __HAL_RCC_GPIOA_CLK_ENABLE();

	  /*Configure GPIO pin Output Level */
	  HAL_GPIO_WritePin(GPIOE, D_Pin|C_Pin, GPIO_PIN_RESET);

	  /*Configure GPIO pin Output Level */
	  HAL_GPIO_WritePin(GPIOB, B_Pin|A_Pin|LAT_Pin, GPIO_PIN_RESET);

	  /*Configure GPIO pin Output Level */
	  HAL_GPIO_WritePin(GPIOD, OE_Pin|CLK_Pin|B2_Pin|G2_Pin, GPIO_PIN_RESET);

	  /*Configure GPIO pin Output Level */
	  HAL_GPIO_WritePin(GPIOC, R2_Pin|B1_Pin, GPIO_PIN_RESET);

	  /*Configure GPIO pin Output Level */
	  HAL_GPIO_WritePin(GPIOA, G1_Pin|R1_Pin, GPIO_PIN_RESET);

	  /*Configure GPIO pins : D_Pin C_Pin */
	  GPIO_InitStruct.Pin = D_Pin|C_Pin;
	  GPIO_InitStruct.Mode = GPIO_MODE_OUTPUT_PP;
	  GPIO_InitStruct.Pull = GPIO_NOPULL;
	  GPIO_InitStruct.Speed = GPIO_SPEED_FREQ_LOW;
	  HAL_GPIO_Init(GPIOE, &GPIO_InitStruct);

	  /*Configure GPIO pins : B_Pin A_Pin LAT_Pin */
	  GPIO_InitStruct.Pin = B_Pin|A_Pin|LAT_Pin;
	  GPIO_InitStruct.Mode = GPIO_MODE_OUTPUT_PP;
	  GPIO_InitStruct.Pull = GPIO_NOPULL;
	  GPIO_InitStruct.Speed = GPIO_SPEED_FREQ_LOW;
	  HAL_GPIO_Init(GPIOB, &GPIO_InitStruct);

	  /*Configure GPIO pins : OE_Pin CLK_Pin B2_Pin G2_Pin */
	  GPIO_InitStruct.Pin = OE_Pin|CLK_Pin|B2_Pin|G2_Pin;
	  GPIO_InitStruct.Mode = GPIO_MODE_OUTPUT_PP;
	  GPIO_InitStruct.Pull = GPIO_NOPULL;
	  GPIO_InitStruct.Speed = GPIO_SPEED_FREQ_LOW;
	  HAL_GPIO_Init(GPIOD, &GPIO_InitStruct);

	  /*Configure GPIO pins : R2_Pin B1_Pin */
	  GPIO_InitStruct.Pin = R2_Pin|B1_Pin;
	  GPIO_InitStruct.Mode = GPIO_MODE_OUTPUT_PP;
	  GPIO_InitStruct.Pull = GPIO_NOPULL;
	  GPIO_InitStruct.Speed = GPIO_SPEED_FREQ_LOW;
	  HAL_GPIO_Init(GPIOC, &GPIO_InitStruct);

	  /*Configure GPIO pins : G1_Pin R1_Pin */
	  GPIO_InitStruct.Pin = G1_Pin|R1_Pin;
	  GPIO_InitStruct.Mode = GPIO_MODE_OUTPUT_PP;
	  GPIO_InitStruct.Pull = GPIO_NOPULL;
	  GPIO_InitStruct.Speed = GPIO_SPEED_FREQ_LOW;
	  HAL_GPIO_Init(GPIOA, &GPIO_InitStruct);

  RAW_DISPLAY = RAW_DISPLAY_0;
}

//HAL_Delay(us);

void led_matrix_setBright(uint16_t Panel_Brightness) {
  TOnLP = Panel_Brightness;
}

static void delay_us (uint16_t us) //create delay function
{
int i=0;
for (i=0; i<=us; i++)
{
	asm("NOP"); //Perform no operation //assembly code
}
}

void led_matrix_loop(void) {
  uint8_t i_m;
  uint8_t bit_mask;
  for (uint8_t RGB333_i = 0; RGB333_i < 3; RGB333_i++) {
  for (uint8_t y_b = 0; y_b < 8; y_b++) {
    digitalWrite(GPIOD, OE_Pin, 1);
    digitalWrite(GPIOB, LAT_Pin, 0);
    for (uint8_t x_b = 0; x_b < 128; x_b++) {
      bit_mask = 1 << (x_b % 8);
      i_m = (y_b * 16) + (x_b / 8);
      digitalWrite(GPIOD, CLK_Pin, 0);
      digitalWrite(GPIOA, R1_Pin, *(RAW_DISPLAY + (RGB333_i * 256) + i_m) & bit_mask);
      digitalWrite(GPIOA, G1_Pin, *(RAW_DISPLAY + ((3+RGB333_i) * 256) + i_m) & bit_mask);
      digitalWrite(GPIOC, B1_Pin, *(RAW_DISPLAY + ((6+RGB333_i)  * 256) + i_m) & bit_mask);
      i_m += 128;
      digitalWrite(GPIOC, R2_Pin, *(RAW_DISPLAY + (RGB333_i * 256) + i_m) & bit_mask);
      digitalWrite(GPIOD, G2_Pin, *(RAW_DISPLAY + ((3+RGB333_i) * 256) + i_m) & bit_mask);
      digitalWrite(GPIOD, B2_Pin, *(RAW_DISPLAY + ((6+RGB333_i) * 256) + i_m) & bit_mask);
      digitalWrite(GPIOD, CLK_Pin, 1);
      if (x_b == 125) {
        digitalWrite(GPIOB, LAT_Pin, 1);
      }
    }
    digitalWrite(GPIOB, A_Pin, y_b & 0b1);
    digitalWrite(GPIOB, B_Pin, y_b & 0b10);
    digitalWrite(GPIOE, C_Pin, y_b & 0b100);
    digitalWrite(GPIOD, OE_Pin, 0);
    delay_us(TOnLP);
  }
  }
}

void led_matrix_setPixel(uint8_t Xp, uint8_t Yp, uint16_t Color3) {
  uint8_t adr[] = {8, 24, 40, 56, 72, 88, 104, 120, 0, 16, 32, 48, 64, 80, 96, 112};
  uint8_t Red_p0 = 0;
  uint8_t Green_p0 = 0;
  uint8_t Blue_p0 = 0;
  uint8_t Red_p1 = 0;
  uint8_t Green_p1 = 0;
  uint8_t Blue_p1 = 0;
  uint8_t Red_p2 = 0;
  uint8_t Green_p2 = 0;
  uint8_t Blue_p2 = 0;
  if (Yp < 16) {
    Yp = adr[Yp] + (Xp / 8);
  } else {
    Yp = adr[Yp - 16] + (Xp / 8) + 128;
  }
  Xp %= 8;
  if (Color3 & 0b100000000) {
	  Red_p0 = 1 << Xp;
  }
  if (Color3 & 0b010000000) {
  	  Red_p1 = 1 << Xp;
    }
  if (Color3 & 0b001000000) {
	  Red_p2 = 1 << Xp;
    }
  if (Color3 & 0b000100000) {
	  Green_p0 = 1 << Xp;
    }
  if (Color3 & 0b000010000) {
	  Green_p1 = 1 << Xp;
    }
  if (Color3 & 0b000001000) {
	  Green_p2 = 1 << Xp;
    }
  if (Color3 & 0b000000100) {
	  Blue_p0 = 1 << Xp;
    }
  if (Color3 & 0b000000010) {
	  Blue_p1 = 1 << Xp;
    }
  if (Color3 & 0b000000001) {
	  Blue_p2 = 1 << Xp;
    }
  if (!(*(RAW_DISPLAY_B + (0 * 256) + Yp) & Red_p0)) {
    if (Red_p0) {
      *(RAW_DISPLAY_B + (0 * 256) + Yp) |= Red_p0;
    }
    else {
      *(RAW_DISPLAY_B + (0 * 256) + Yp) &= ~(1 << Xp);
    }
  }
  if (!(*(RAW_DISPLAY_B + (1 * 256) + Yp) & Red_p1)) {
    if (Red_p1) {
      *(RAW_DISPLAY_B + (1 * 256) + Yp) |= Red_p1;
    }
    else {
      *(RAW_DISPLAY_B + (1 * 256) + Yp) &= ~(1 << Xp);
    }
  }
  if (!(*(RAW_DISPLAY_B + (2 * 256) + Yp) & Red_p2)) {
    if (Red_p2) {
      *(RAW_DISPLAY_B + (2 * 256) + Yp) |= Red_p2;
    }
    else {
      *(RAW_DISPLAY_B + (2 * 256) + Yp) &= ~(1 << Xp);
    }
  }
  if (!(*(RAW_DISPLAY_B + (3 * 256) + Yp) & Green_p0)) {
      if (Green_p0) {
        *(RAW_DISPLAY_B + (3 * 256) + Yp) |= Green_p0;
      }
      else {
        *(RAW_DISPLAY_B + (3 * 256) + Yp) &= ~(1 << Xp);
      }
  }
  if (!(*(RAW_DISPLAY_B + (4 * 256) + Yp) & Green_p1)) {
      if (Green_p1) {
        *(RAW_DISPLAY_B + (4 * 256) + Yp) |= Green_p1;
      }
      else {
        *(RAW_DISPLAY_B + (4 * 256) + Yp) &= ~(1 << Xp);
      }
  }
  if (!(*(RAW_DISPLAY_B + (5 * 256) + Yp) & Green_p2)) {
      if (Green_p2) {
        *(RAW_DISPLAY_B + (5 * 256) + Yp) |= Green_p2;
      }
      else {
        *(RAW_DISPLAY_B + (5 * 256) + Yp) &= ~(1 << Xp);
      }
  }
  if (!(*(RAW_DISPLAY_B + (6 * 256) + Yp) & Blue_p0)) {
      if (Blue_p0) {
        *(RAW_DISPLAY_B + (6 * 256) + Yp) |= Blue_p0;
      }
      else {
        *(RAW_DISPLAY_B + (6 * 256) + Yp) &= ~(1 << Xp);
      }
  }
  if (!(*(RAW_DISPLAY_B + (7 * 256) + Yp) & Blue_p1)) {
      if (Blue_p1) {
        *(RAW_DISPLAY_B + (7 * 256) + Yp) |= Blue_p1;
      }
      else {
        *(RAW_DISPLAY_B + (7 * 256) + Yp) &= ~(1 << Xp);
      }
  }
  if (!(*(RAW_DISPLAY_B + (8 * 256) + Yp) & Blue_p2)) {
      if (Blue_p2) {
        *(RAW_DISPLAY_B + (8 * 256) + Yp) |= Blue_p2;
      }
      else {
        *(RAW_DISPLAY_B + (8 * 256) + Yp) &= ~(1 << Xp);
      }
  }
}

void led_matrix_clear(void) {
  uint16_t i_p;
  for (i_p = 0; i_p < 2304; i_p++) {
    *(RAW_DISPLAY_B + i_p) = 0;
  }
}

void led_matrix_switchBuff(void) {
  swbuff = !swbuff;
  if (swbuff) {
    RAW_DISPLAY = RAW_DISPLAY_1;
    RAW_DISPLAY_B = RAW_DISPLAY_0;
  }
  else {
    RAW_DISPLAY = RAW_DISPLAY_0;
    RAW_DISPLAY_B = RAW_DISPLAY_1;
  }
}
